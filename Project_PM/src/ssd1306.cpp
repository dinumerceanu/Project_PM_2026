#include "ssd1306.h"
#include "twi.h"
#include <avr/pgmspace.h>

/*
 * 5x7 bitmap font for ASCII characters 32 (' ') to 90 ('Z').
 * Each character is represented as 5 columns of 8 bits.
 * Stored in program memory (Flash) to save RAM.
 */
static const uint8_t font[][5] PROGMEM = {
    {0x00,0x00,0x00,0x00,0x00}, // ' '
    {0x00,0x00,0x5F,0x00,0x00}, // '!'
    {0x00,0x07,0x00,0x07,0x00}, // '"'
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    {0x61,0x51,0x49,0x45,0x43}, // 'Z'
};

/*
 * Sends a single command byte to the SSD1306.
 * Uses I2C control byte 0x00 (Co=0, D/C=0) to signal a command.
 */
static void ssd1306_cmd(uint8_t cmd)
{
    twi_start();
    twi_write(SSD1306_ADDR << 1);
    twi_write(0x00);
    twi_write(cmd);
    twi_stop();
}

/*
 * Sends a single data byte to the SSD1306 display RAM.
 * Uses I2C control byte 0x40 (Co=0, D/C=1) to signal data.
 */
static void ssd1306_data(uint8_t data)
{
    twi_start();
    twi_write(SSD1306_ADDR << 1);
    twi_write(0x40);
    twi_write(data);
    twi_stop();
}

/*
 * Initializes the SSD1306 OLED display.
 * Sends the standard initialization command sequence:
 * turns off the display, configures clock, multiplexer, charge pump,
 * addressing mode, segment/COM direction, contrast, and finally turns on the display.
 */
void ssd1306_init(void)
{
    ssd1306_cmd(0xAE); // display off
    ssd1306_cmd(0xD5); ssd1306_cmd(0x80); // clock divider
    ssd1306_cmd(0xA8); ssd1306_cmd(0x3F); // multiplex ratio (64 rows)
    ssd1306_cmd(0xD3); ssd1306_cmd(0x00); // display offset
    ssd1306_cmd(0x40);                     // start line = 0
    ssd1306_cmd(0x8D); ssd1306_cmd(0x14); // charge pump enabled
    ssd1306_cmd(0x20); ssd1306_cmd(0x00); // horizontal addressing mode
    ssd1306_cmd(0xA1);                     // segment remap (col 127 = SEG0)
    ssd1306_cmd(0xC8);                     // COM scan direction remapped
    ssd1306_cmd(0xDA); ssd1306_cmd(0x12); // COM pins hardware config
    ssd1306_cmd(0x81); ssd1306_cmd(0xCF); // contrast
    ssd1306_cmd(0xD9); ssd1306_cmd(0xF1); // pre-charge period
    ssd1306_cmd(0xDB); ssd1306_cmd(0x40); // VCOMH deselect level
    ssd1306_cmd(0xA4);                     // output follows RAM content
    ssd1306_cmd(0xA6);                     // normal display (not inverted)
    ssd1306_cmd(0xAF);                     // display on
}

/*
 * Clears the entire display by writing 0x00 to all pixels in all 8 pages.
 * Each page is 128 columns wide and 8 pixels tall (128x64 total).
 */
void ssd1306_clear(void)
{
    for (uint8_t page = 0; page < 8; page++) {
        ssd1306_cmd(0xB0 + page); // set page address
        ssd1306_cmd(0x00);         // set column low nibble
        ssd1306_cmd(0x10);         // set column high nibble
        for (uint8_t col = 0; col < 128; col++) {
            ssd1306_data(0x00);
        }
    }
}

/*
 * Prints a null-terminated string on the display at the specified row (page 0-7).
 * Characters are rendered using the 5x7 font stored in Flash memory.
 * Only uppercase letters (A-Z), digits (0-9), and basic punctuation are supported.
 * Unsupported characters are replaced with a space.
 */
void ssd1306_print_str(const char *str, uint8_t row)
{
    ssd1306_cmd(0xB0 + row); // set page/row
    ssd1306_cmd(0x00);        // set column low nibble
    ssd1306_cmd(0x10);        // set column high nibble

    while (*str) {
        char c = *str++;
        if (c < ' ' || c > 'Z') c = ' ';
        for (uint8_t i = 0; i < 5; i++) {
            ssd1306_data(pgm_read_byte(&font[c - ' '][i]));
        }
        ssd1306_data(0x00); // one pixel gap between characters
    }
}
